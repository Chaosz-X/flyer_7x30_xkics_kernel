## kernel/power/Kconfig.rej
```kconfig
--- kernel/power/Kconfig
+++ kernel/power/Kconfig
@@ -325,6 +325,13 @@
 	depends on PM_SLEEP || PM_RUNTIME
 	default y
 
+config SUSPEND_TIME
+	bool "Log time spent in suspend"
+	---help---
+	  Prints the time spent in suspend in the kernel log, and
+	  keeps statistics on the time spent in suspend in
+	  /sys/kernel/debug/suspend_time
+
 config PM_OPP
 	bool "Operating Performance Point (OPP) Layer library"
 	depends on PM
```
